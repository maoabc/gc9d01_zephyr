## display/Kconfig
```kconfig
# Display drivers

# Copyright (c) 2017 Intel Corporation
# SPDX-License-Identifier: Apache-2.0

menuconfig DISPLAY
	bool "Display controller drivers"
	help
	  Enable display drivers

if DISPLAY

config DISPLAY_INIT_PRIORITY
	int "Display devices init priority"
	default 85
	help
	  Display devices initialization priority.


module = gc9d01
module-str = "gc9d01"
source "subsys/logging/Kconfig.template.log_config"

# Why can't load? ? ?
#source "Kconfig.gc9d01"

config GC9D01
	bool "GC9D01 display driver"
	default y
	depends on DT_HAS_GALAXYCORE_GC9D01_ENABLED
	select MIPI_DBI
	help
	  Enable driver for GC9D01 display driver.

endif # DISPLAY
```

## display/Kconfig.gc9d01
```kconfig
# Copyright 2023 Martin Kiepfer <mrmarteng@teleschirm.org>
# SPDX-License-Identifier: Apache-2.0

config GC9D01
	bool "GC9D01 display driver"
	default y
	depends on DT_HAS_GALAXYCORE_GC9D01_ENABLED
	select MIPI_DBI
	help
	  Enable driver for GC9D01 display driver.
```

## dts/bindings/display/galaxycore,gc9d01.yaml
```yaml
# Copyright (c) 2025 maoabc.
# Copyright (c) 2023 Mr Beam Lasers GmbH.
# Copyright (c) 2023 Amrith Venkat Kesavamoorthi <amrith@mr-beam.org>
# Copyright (c) 2023 Martin Kiepfer <mrmarteng@teleschirm.org>
# SPDX-License-Identifier: Apache-2.0

description: |
  GC9D01 display driver.

  This driver implements support for various GC9D01 graphics
  controllers and different display sizes. It has been validated
  for following controllers:
   - GC9D01: (0.99inch round lcd display 40x160)

  Here is an example to define a display interface:

  / {
      my_mipi_dbi {
          compatible = "zephyr,mipi-dbi-spi";
          status = "okay";
          #address-cells = <1>;
          #size-cells = <0>;
          spi-dev = <&spi2>;
          dc-gpios = <&gpio0 4 GPIO_ACTIVE_HIGH>;
          reset-gpios = <&gpio0 8 GPIO_ACTIVE_LOW>;

          gc9d01_lcd: gc9d01_lcd@0 {
              compatible = "galaxycore,gc9d01";
              reg = <0>;
              mipi-max-frequency = <DT_FREQ_M(10)>;
              pixel-format = <PANEL_PIXEL_FORMAT_RGB_565>;
              width = <240>;
              height = <240>;
              display-inversion;
          };
      };
  };


compatible: "galaxycore,gc9d01"

include: [mipi-dbi-spi-device.yaml, display-controller.yaml, lcd-controller.yaml]

properties:
  orientation:
    type: string
    default: "normal"
    enum:
      - "normal"
      - "90"
      - "180"
      - "270"
    description: Display orientation (CW) in degrees.

  display-inversion:
    type: boolean
    description: |
      Display inversion mode. Every bit is inverted from the frame memory to
      the display.

  pwrctrl1:
    type: uint8-array
    default: [
      0x00
    ]
    description: Power-control 1 register value

  pwrctrl2:
    type: uint8-array
    default: [
      0x2c
    ]
    description: Power-control 2 register value

  pwrctrl3:
    type: uint8-array
    default: [
      0x1a
    ]
    description: Power-control 3 register value

  pwrctrl4:
    type: uint8-array
    default: [
      0x28
    ]
    description: Power-control 4 register value

  gamma1:
    type: uint8-array
    default: [
      0x51,
      0x13,
      0x0c,
      0x06,
      0x00,
      0x2F
    ]
    description: Gamma correction 1 register values (negative polarity)

  gamma2:
    type: uint8-array
    default: [
      0x3c,
      0x94,
      0x4f,
      0x33,
      0x34,
      0xcf
    ]
    description: Gamma correction 3 register values

  gamma3:
    type: uint8-array
    default: [
      0x51,
      0x13,
      0x0c,
      0x06,
      0x00,
      0x33
    ]
    description: Gamma correction 3 register values (positive polarity)

  gamma4:
    type: uint8-array
    default: [
      0x4d,
      0x94,
      0x4f,
      0x33,
      0x34,
      0xcf
    ]
    description: Gamma correction 4 register values
```
